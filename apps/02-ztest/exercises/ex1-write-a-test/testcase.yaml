## apps/11-renode-twister/testcase.yaml
```yaml
tests:
  app11.button.robot:
    platform_allow:
      - nrf52840dk/nrf52840/renode
    harness: robot
    harness_config:
      robot_testsuite: tests/robot/button_toggle.robot
```

## dump/tests/biz_logic/testcase.yaml
```yaml
tests:
  biz_logic.testing.ztest:
    build_only: false
    platform_allow:
      - native_sim
    integration_platforms:
      - native_sim
    tags: test_framework
    extra_args: DTC_OVERLAY_FILE="../../boards/native_sim.overlay"
```
