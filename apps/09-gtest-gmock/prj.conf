## CMakeLists.txt
```
cmake_minimum_required(VERSION 3.20)
find_package(Zephyr REQUIRED HINTS $ENV{ZEPHYR_BASE})
project(feeder_cpp CXX)

target_sources(app PRIVATE
    src/main.cpp
    src/dispenser.cpp
)

target_include_directories(app PRIVATE include src)
```

## prj.conf
```kconfig
CONFIG_PRINTK=y

# C++ with -std=c++2b, needed for std::to_underlying in portion.hpp.
CONFIG_CPP=y
CONFIG_STD_CPP2B=y

# Full C++ standard library: the minimal one has no <utility> or <cerrno>.
# See tests/gtest/prj.conf for why this symbol and not CONFIG_GLIBCXX_LIBCPP.
CONFIG_REQUIRES_FULL_LIBCPP=y
```

## boards/native_sim_native.conf
```kconfig
# Put the first PTY UART on the stdin/stdout of the shell that launched
# zephyr.exe, so `./build/zephyr/zephyr.exe` prints straight into your
# terminal instead of allocating a separate pty you have to attach to.
#
# Zephyr picks this file up automatically for board target native_sim/native.
# The filename is the board target with '/' replaced by '_'.
CONFIG_UART_NATIVE_PTY_0_ON_STDINOUT=y
```

## src/main.cpp
```c
// Composition root: wires a BeltAuger to a Dispenser and feeds once a second.
// tests/gtest brings its own main() and auger, so the dispenser never has to know.

#include <zephyr/kernel.h>
#include <zephyr/sys/printk.h>

#include "belt_auger.hpp"
#include "feeder/dispenser.hpp"
#include "feeder/portion.hpp"

int main(void)
{
    printk("Pond feeder dispenser starting\n");

    feeder::BeltAuger auger;
    feeder::Dispenser dispenser(auger);

    while (true) {
        const int ret = dispenser.feed(feeder::gramsOf(feeder::Portion::Large));

        printk("feed -> %d | total %u g | jams %u\n",
               ret, dispenser.dispensed(), dispenser.jams());

        k_sleep(K_SECONDS(1));
    }

    return 0;
}
```

## src/belt_auger.hpp
```c
// The app's shipping IAuger, not a test double. Jams every seventh turn so
// src/main.cpp has something to print. Nothing asserts on it, so unlike a mock
// it is allowed to be inaccurate.

#pragma once

#include <cerrno>

#include <zephyr/sys/printk.h>

#include "feeder/auger.hpp"

namespace feeder {

class BeltAuger final : public IAuger {
public:
    [[nodiscard]] int run(std::uint16_t grams) override
    {
        if (++turns_ % 7 == 0) {
            printk("auger: JAM\n");
            return -EIO;
        }

        printk("auger: %u g\n", grams);
        return 0;
    }

private:
    std::uint32_t turns_{0};
};

}  // namespace feeder
```

## src/dispenser.cpp
```c
#include "feeder/dispenser.hpp"

#include <cerrno>

#include "feeder/portion.hpp"

namespace feeder {

int Dispenser::feed(std::uint16_t grams)
{
    if (grams == 0) {
        return -EINVAL;
    }

    const std::uint8_t turns = turnsFor(grams);

    for (std::uint8_t i = 0; i < turns; ++i) {
        const int ret = auger_.run(kGramsPerTurn);

        if (ret != 0) {
            // Stop on a jam: it usually means the hopper bridged, and another turn
            // would grind the same blockage. Grams already dispensed stay counted.
            ++jams_;
            return ret;
        }

        dispensed_g_ += kGramsPerTurn;
    }

    return 0;
}

}  // namespace feeder
```

## src/logic.cpp
```c
// src/logic.cpp

#include "climate/logic.hpp"

namespace climate {

std::int32_t toMilli(std::int32_t val1, std::int32_t val2) {
    std::int32_t milli = val2 / 1000;
    const std::int32_t rem = val2 % 1000;

    if (rem >= 500) {
        milli += 1;
    } else if (rem <= -500) {
        milli -= 1;
    }

    return val1 * 1000 + milli;
}

bool alarmState(std::int32_t temp_mc, std::int32_t hum_mrh, bool prev) {
    if (prev) {
        return temp_mc > kTempOffMilliC || hum_mrh > kHumOffMilliRh;
    }

    return temp_mc >= kTempOnMilliC || hum_mrh >= kHumOnMilliRh;
}

}  // namespace climate
```

## src/sawtooth_sensor.hpp
```c
// src/sawtooth_sensor.hpp
//
// A production implementation, not a test double. It walks temperature up and
// down so src/main.cpp has something to print.
//
// The distinction gets blurred constantly: a fake that ships is a simulator,
// and it is allowed to be wrong in ways a mock is not, because nobody is
// asserting on it.

#pragma once

#include <zephyr/sys/printk.h>

#include "climate/ports.hpp"

namespace climate {

class SawtoothSensor final : public ISensorPort {
public:
    [[nodiscard]] bool ready() const override { return true; }

    [[nodiscard]] int read(Reading& out) override
    {
        temp_mc_ += step_;
        hum_mrh_ += step_ * 3;
        if (temp_mc_ > 32000 || temp_mc_ < 24000) {
            step_ = -step_;
        }

        out.temp_mc = temp_mc_;
        out.hum_mrh = hum_mrh_;
        out.press_pa = 100650;
        return 0;
    }

private:
    std::int32_t temp_mc_{24000};
    std::int32_t hum_mrh_{55000};
    std::int32_t step_{500};
};

class LedAlarm final : public IAlarmPort {
public:
    void set(bool on) override { printk("alarm: %s\n", on ? "ON" : "OFF"); }
};

}  // namespace climate
```

## src/service.cpp
```c
// src/service.cpp

#include "climate/service.hpp"

#include <cerrno>

#include "climate/logic.hpp"

namespace climate {

Service::Service(ISensorPort& sensor, IAlarmPort& alarm)
    : sensor_(sensor), alarm_port_(alarm) {}

void Service::clearFault() {
    faulted_ = false;
    consecutive_errors_ = 0;
}

int Service::tick() {
    if (faulted_) {
        return -EIO;
    }

    Reading raw{};
    const int ret = sensor_.read(raw);

    if (ret != 0) {
        ++errors_;
        ++consecutive_errors_;

        if (consecutive_errors_ >= kMaxConsecutiveErrors) {
            faulted_ = true;
        }

        // Deliberately leaves the alarm alone. A sensor that stopped
        // answering is not a sensor saying everything is fine.
        return ret;
    }

    consecutive_errors_ = 0;
    ++reads_;
    last_ = raw;

    const bool next = alarmState(raw.temp_mc, raw.hum_mrh, alarm_);

    // Edge only. This is the line the mock test is really about.
    if (next != alarm_) {
        alarm_ = next;
        alarm_port_.set(next);
    }

    return 0;
}

}  // namespace climate
```
