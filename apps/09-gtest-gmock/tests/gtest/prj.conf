## CMakeLists.txt
```
# Zephyr test app with GoogleTest compiled into it.
#
# FetchContent_Populate, not FetchContent_MakeAvailable: the latter runs
# googletest's own CMakeLists, whose compiler and standard flags fight Zephyr's.
# Compiling the two fused sources here keeps every flag under Zephyr's control.

cmake_minimum_required(VERSION 3.20.0)

find_package(Zephyr REQUIRED HINTS $ENV{ZEPHYR_BASE})
project(feeder_gtest CXX)

# --------------------------------------------------------------------------
# GoogleTest source. Without network access, clone it once and pass the path:
#   west build ... -- -DGTEST_SRC_DIR=/path/to/googletest
# --------------------------------------------------------------------------

set(GTEST_SRC_DIR "" CACHE PATH "An existing googletest checkout, instead of downloading one")

if(NOT GTEST_SRC_DIR)
    include(FetchContent)
    FetchContent_Declare(googletest
        URL https://github.com/google/googletest/archive/refs/tags/v1.15.2.tar.gz
        DOWNLOAD_EXTRACT_TIMESTAMP TRUE
    )
    FetchContent_GetProperties(googletest)
    if(NOT googletest_POPULATED)
        FetchContent_Populate(googletest)
    endif()
    set(GTEST_SRC_DIR ${googletest_SOURCE_DIR})
endif()

message(STATUS "googletest source: ${GTEST_SRC_DIR}")

# --------------------------------------------------------------------------
# Trim GoogleTest to what a Zephyr target provides.
#
# zephyr_compile_definitions(), not a per-file define: these change the layout
# of gtest's types, so gtest and every test including its headers must agree.
#
# GTEST_HAS_FILE_SYSTEM stays on: =0 removes posix::Close, which
# gtest-death-test-internal.h still calls, so gtest's own headers fail to build.
# --------------------------------------------------------------------------

zephyr_compile_definitions(
    GTEST_HAS_PTHREAD=0      # Zephyr threads are not pthreads as far as gtest cares
)

# GTEST_HAS_DEATH_TEST is left alone: gtest-port.h defines it itself, so a
# command-line define warns "redefined", which fails Twister's -Werror build.

zephyr_include_directories(
    ${GTEST_SRC_DIR}/googletest/include
    ${GTEST_SRC_DIR}/googlemock/include
)

# --------------------------------------------------------------------------
# Everything, GoogleTest included, goes into `app`. A separate
# zephyr_library_named(googletest) builds but is never linked, because an
# application-level library is not added to ZEPHYR_LIBS.
#
# The app's src/main.cpp is left out: this directory brings its own main(),
# and MockAuger in test_dispenser.cpp is the only IAuger in this binary.
# --------------------------------------------------------------------------

target_sources(app PRIVATE
    ${CMAKE_CURRENT_SOURCE_DIR}/src/main.cpp
    ${CMAKE_CURRENT_SOURCE_DIR}/src/test_portion.cpp
    ${CMAKE_CURRENT_SOURCE_DIR}/src/test_dispenser.cpp
    ${CMAKE_CURRENT_SOURCE_DIR}/../../src/dispenser.cpp

    ${GTEST_SRC_DIR}/googletest/src/gtest-all.cc
    ${GTEST_SRC_DIR}/googlemock/src/gmock-all.cc
)

target_include_directories(app PRIVATE
    ${CMAKE_CURRENT_SOURCE_DIR}/../../include
    ${GTEST_SRC_DIR}/googletest
    ${GTEST_SRC_DIR}/googlemock
)

# Third-party source, so its warnings are suppressed rather than fixed.
set_source_files_properties(
    ${GTEST_SRC_DIR}/googletest/src/gtest-all.cc
    ${GTEST_SRC_DIR}/googlemock/src/gmock-all.cc
    PROPERTIES COMPILE_OPTIONS "-w"
)
```

## prj.conf
```kconfig
CONFIG_PRINTK=y
CONFIG_STDOUT_CONSOLE=y

CONFIG_CPP=y
CONFIG_STD_CPP2B=y

# GoogleTest and gmock need exceptions, RTTI and a full standard library.
# REQUIRES_FULL_LIBCPP, not GLIBCXX_LIBCPP: the latter depends on NEWLIB_LIBC
# or PICOLIBC, which native_sim does not use, so Kconfig silently drops it.
# See the Trivia section of the README.
CONFIG_CPP_EXCEPTIONS=y
CONFIG_CPP_RTTI=y
CONFIG_REQUIRES_FULL_LIBCPP=y

# 256 kB heap and 32 kB main stack: every TEST and EXPECT_CALL registers
# before main() and gtest allocates freely, far beyond a normal Zephyr app.
CONFIG_HEAP_MEM_POOL_SIZE=262144
CONFIG_MAIN_STACK_SIZE=32768
```

## src/main.cpp
```c
// GoogleTest entry point; unlike ztest, GoogleTest does not generate main().
// No ztest suite or runner: `harness: gtest` in testcase.yaml reads the console
// output and reports one result per test.

#include <zephyr/kernel.h>

#include <gmock/gmock.h>

#if defined(CONFIG_ARCH_POSIX)
// Returning from main() does not end a native_sim run, so the process would idle
// until twister's timeout. nsi_exit() shuts the simulator down; the native_sim
// board already puts nsi_main.h on the include path.
#include <nsi_main.h>
#endif

int main(void)
{
    // GoogleTest parses argv for --gtest_filter and similar. Zephyr's main()
    // takes no arguments, so pass a one-element argv.
    int argc = 1;
    char arg0[] = "zephyr";
    char *argv[] = {arg0, nullptr};

    testing::InitGoogleMock(&argc, argv);

    const int failures = RUN_ALL_TESTS();

#if defined(CONFIG_ARCH_POSIX)
    nsi_exit(failures);
#endif

    return failures;
}
```

## src/test_dispenser.cpp
```c
// The same questions as apps/08-fff-mocks/tests/fff/src/main.c, asked with gmock.
//
// FFF:   call the code, then assert on auger_run_fake.call_count.
// gmock: state the expectation before the call. An unmet EXPECT_CALL fails the
//        test when the mock is destroyed, with no assertion written.
//
// gmock catches the call you forgot to assert on; FFF needs no C++ runtime,
// exceptions or RTTI.

#include <cerrno>
#include <cstdint>

#include <gmock/gmock.h>
#include <gtest/gtest.h>

#include "feeder/dispenser.hpp"
#include "feeder/portion.hpp"

namespace {

using testing::_;
using testing::Return;

class MockAuger : public feeder::IAuger {
public:
    MOCK_METHOD(int, run, (std::uint16_t grams), (override));
};

TEST(Dispenser, SplitsAPortionIntoWholeTurns)
{
    MockAuger auger;

    // The argument is part of the expectation: three calls to run(100) would
    // not match, and the test would fail without any EXPECT_EQ.
    EXPECT_CALL(auger, run(feeder::kGramsPerTurn)).Times(3).WillRepeatedly(Return(0));

    feeder::Dispenser dispenser(auger);

    EXPECT_EQ(dispenser.feed(750), 0);
    EXPECT_EQ(dispenser.dispensed(), 750u);
}

TEST(Dispenser, ZeroGramsNeverReachesTheMotor)
{
    MockAuger auger;

    // No call to run() at all, which watching a motor cannot prove.
    EXPECT_CALL(auger, run(_)).Times(0);

    feeder::Dispenser dispenser(auger);

    EXPECT_EQ(dispenser.feed(0), -EINVAL);
}

TEST(Dispenser, AJamStopsTheRemainingTurns)
{
    MockAuger auger;

    // One answer per call, in order. Two WillOnce clauses also set the expected
    // count, so a third call would fail on its own.
    EXPECT_CALL(auger, run(feeder::kGramsPerTurn))
        .WillOnce(Return(0))
        .WillOnce(Return(-EIO));

    feeder::Dispenser dispenser(auger);

    EXPECT_EQ(dispenser.feed(750), -EIO);
    EXPECT_EQ(dispenser.dispensed(), 250u) << "counted pellets that never left the hopper";
    EXPECT_EQ(dispenser.jams(), 1u);
}

}  // namespace
```

## src/test_logic.cpp
```c
// tests/test_logic.cpp
//
// Plain GoogleTest, no mocks. The same assertions as apps/06-sensor's
// tests/unit, so put the two files next to each other and read what the
// framework buys you.
//
// The short version: ztest has no parametrization, so a table of cases becomes
// one test that stops at the first failure. GoogleTest has TEST_P, so the same
// table becomes one result per row with a name attached.

#include <cctype>
#include <ostream>
#include <initializer_list>
#include <string>
#include <vector>

// EXPECT_THAT and the matchers below live in gmock, not gtest, even when no
// mock object is involved. gmock_main links both, so the include is all you
// need.
#include <gmock/gmock.h>
#include <gtest/gtest.h>

#include "climate/logic.hpp"

namespace {

using climate::alarmState;
using climate::toMilli;

// --------------------------------------------------------------------------
// Tests that never run.
//
// Both functions in logic.hpp are `constexpr`, so the compiler can evaluate
// them. That makes these assertions build errors rather than test failures,
// and they cost nothing at run time because there is no run time involved.
//
// The limit is that a static_assert reports one failure and stops, and it
// cannot tell you "9 cases ran, case 4 disagreed". Use it for the handful of
// properties you never want to compile without, and TEST_P below for the
// table.
// --------------------------------------------------------------------------

static_assert(toMilli(25, 0) == 25000);
static_assert(toMilli(25, 500500) == 25501, "halves round away from zero");
static_assert(toMilli(-25, -500500) == -25501, "and that includes negatives");
static_assert(toMilli(0, 999999) == 1000, "truncating here would give 999");

static_assert(!alarmState(20000, 40000, false), "cold and dry stays off");
static_assert(alarmState(climate::kTempOnMilliC, 40000, false), "trips on the point");
static_assert(alarmState(29000, 40000, true), "inside the band it holds");
static_assert(!alarmState(climate::kTempOffMilliC, 40000, true), "releases on the point");

// --------------------------------------------------------------------------
// TEST: the plain one. Suite name, test name, body.
// --------------------------------------------------------------------------

TEST(ToMilli, WholeUnitsPassThrough) {
    EXPECT_EQ(toMilli(25, 0), 25000);
}

TEST(ToMilli, RoundsHalfUp) {
    EXPECT_EQ(toMilli(25, 500500), 25501);
}

TEST(ToMilli, RoundsNegativeHalfAwayFromZero) {
    EXPECT_EQ(toMilli(-25, -500500), -25501);
}

TEST(ToMilli, TruncationWouldLoseThis) {
    // 999999 micro-units is 1000 milli-units once rounded, not 999.
    EXPECT_EQ(toMilli(0, 999999), 1000);
}

// EXPECT_ vs ASSERT_ is the first thing to get right and the most commonly
// missed. EXPECT_ records the failure and keeps going, so one run tells you
// about all four problems. ASSERT_ returns from the function immediately, and
// you use it when continuing would crash or would be meaningless.
TEST(ToMilli, ExpectKeepsGoingWhereAssertWouldNot) {
    EXPECT_EQ(toMilli(1, 0), 1000);
    EXPECT_EQ(toMilli(2, 0), 2000);
    EXPECT_EQ(toMilli(3, 0), 3000);
}

// --------------------------------------------------------------------------
// TEST_P: one body, a table of cases, and one result per row.
// --------------------------------------------------------------------------

struct AlarmCase {
    const char* name;
    std::int32_t temp_mc;
    std::int32_t hum_mrh;
    bool prev;
    bool want;
};

// Teach GoogleTest how to print an AlarmCase.
//
// Without this it falls back to a hex dump of the struct, and you get lines
// like `GetParam() = 24-byte object <93-02 10-2E ...>` in the listing. CMake's
// gtest_discover_tests uses exactly that string as the ctest test name, so a
// missing PrintTo is how you end up with a ctest report nobody can read.
// Found by running `ctest -N` and looking at it, which is worth doing once
// for any suite you inherit.
void PrintTo(const AlarmCase& c, std::ostream* os) { *os << c.name; }

class AlarmHysteresis : public testing::TestWithParam<AlarmCase> {};

TEST_P(AlarmHysteresis, MatchesTheTruthTable) {
    const AlarmCase& c = GetParam();

    EXPECT_EQ(alarmState(c.temp_mc, c.hum_mrh, c.prev), c.want)
        << "temp=" << c.temp_mc << " hum=" << c.hum_mrh << " prev=" << c.prev;
}

INSTANTIATE_TEST_SUITE_P(
    Thresholds, AlarmHysteresis,
    testing::Values(
        AlarmCase{"cold and dry stays off", 20000, 40000, false, false},
        AlarmCase{"exactly on the temp trip", climate::kTempOnMilliC, 40000, false, true},
        AlarmCase{"one below the temp trip", climate::kTempOnMilliC - 1, 40000, false, false},
        AlarmCase{"humidity alone can trip it", 20000, climate::kHumOnMilliRh, false, true},
        AlarmCase{"inside the band stays latched", 29000, 40000, true, true},
        AlarmCase{"exactly on the release point", climate::kTempOffMilliC, 40000, true, false},
        AlarmCase{"one above the release point", climate::kTempOffMilliC + 1, 40000, true, true},
        AlarmCase{"humidity alone holds it", 20000, climate::kHumOffMilliRh + 1, true, true},
        AlarmCase{"both below releases", 20000, 40000, true, false}),
    [](const testing::TestParamInfo<AlarmCase>& info) {
        // Without this lambda the cases are named Thresholds/AlarmHysteresis.0
        // through .8, and a red CI log tells you nothing. Worth the five lines
        // every single time.
        std::string s = info.param.name;
        for (char& ch : s) {
            if (!std::isalnum(static_cast<unsigned char>(ch))) {
                ch = '_';
            }
        }
        return s;
    });

// --------------------------------------------------------------------------
// TEST_F: a fixture, for setup shared across tests.
// --------------------------------------------------------------------------

class AlarmWalk : public testing::Test {
protected:
    void SetUp() override { state_ = false; }

    // Feed a series of temperatures through the hysteresis and record every
    // state it passed through.
    std::vector<bool> walk(std::initializer_list<std::int32_t> temps) {
        std::vector<bool> out;
        for (std::int32_t t : temps) {
            state_ = alarmState(t, 40000, state_);
            out.push_back(state_);
        }
        return out;
    }

    bool state_{false};
};

TEST_F(AlarmWalk, DoesNotChatterOnTheThreshold) {
    // Sitting exactly on the trip point is the case hysteresis exists for.
    const auto seen = walk({30000, 30000, 30000, 30000});

    EXPECT_THAT(seen, testing::Each(true));
}

TEST_F(AlarmWalk, RisesAndFallsOnce) {
    const auto seen = walk({20000, 31000, 29000, 27000, 20000});

    EXPECT_THAT(seen, testing::ElementsAre(false, true, true, false, false));
}

}  // namespace
```

## src/test_portion.cpp
```c
// Plain GoogleTest, no mocks. TEST(Suite, Name) does the job ZTEST does in
// apps/07-unit-conventions.

#include <cstdint>

#include <gtest/gtest.h>

#include "feeder/portion.hpp"

namespace {

// turnsFor is constexpr, so these are checked at compile time and fail the
// build instead of a test run.
static_assert(feeder::turnsFor(0) == 0);
static_assert(feeder::turnsFor(250) == 1);
static_assert(feeder::turnsFor(251) == 2);
static_assert(feeder::turnsFor(feeder::gramsOf(feeder::Portion::Large)) == 3);

TEST(TurnsFor, NothingAskedIsNoTurns)
{
    EXPECT_EQ(feeder::turnsFor(0), 0);
}

TEST(TurnsFor, ExactMultiplesAreWholeTurns)
{
    EXPECT_EQ(feeder::turnsFor(feeder::kGramsPerTurn), 1);
    EXPECT_EQ(feeder::turnsFor(feeder::gramsOf(feeder::Portion::Large)), 3);
}

TEST(TurnsFor, AnyRemainderCostsAnotherTurn)
{
    // Rounding down would shrink a 300 g portion to 250 g, every time.
    EXPECT_EQ(feeder::turnsFor(1), 1);
    EXPECT_EQ(feeder::turnsFor(feeder::kGramsPerTurn + 1), 2);
}

}  // namespace
```

## src/test_service.cpp
```c
// tests/test_service.cpp
//
// GoogleMock, against the same Service that apps/08-fff-mocks tests with FFF.
// The two suites assert the same things, so the difference you are looking at
// is purely the framework.
//
// The big one: FFF records and you assert afterwards. gmock declares the
// expectation up front with EXPECT_CALL, and the mock itself fails the test at
// destruction if the expectation was not met. That reads better, and it has a
// real cost attached, which the StrictMock and NiceMock section below is
// about.

#include <cerrno>
#include <vector>

#include <gmock/gmock.h>
#include <gtest/gtest.h>

#include "climate/logic.hpp"
#include "climate/service.hpp"

namespace {

using climate::Reading;
using climate::Service;

using testing::_;
using testing::AtLeast;
using testing::DoAll;
using testing::Field;
using testing::InSequence;
using testing::IsTrue;
using testing::NiceMock;
using testing::Return;
using testing::SetArgReferee;
using testing::StrictMock;

// --------------------------------------------------------------------------
// The mocks. Four lines each, and MOCK_METHOD generates the override, the
// expectation plumbing and the failure reporting.
// --------------------------------------------------------------------------

class MockSensorPort : public climate::ISensorPort {
public:
    MOCK_METHOD(bool, ready, (), (const, override));
    MOCK_METHOD(int, read, (Reading & out), (override));
};

class MockAlarmPort : public climate::IAlarmPort {
public:
    MOCK_METHOD(void, set, (bool on), (override));
};

Reading quiet() { return Reading{25000, 100000, 45000}; }
Reading hot() { return Reading{climate::kTempOnMilliC + 500, 100000, 45000}; }
Reading cool() { return Reading{climate::kTempOffMilliC - 500, 100000, 40000}; }

// --------------------------------------------------------------------------
// 1. The basic shape: expectation, action, verification on destruction.
// --------------------------------------------------------------------------

TEST(ServiceMock, TickReadsTheSensorExactlyOnce) {
    MockSensorPort sensor;
    NiceMock<MockAlarmPort> alarm;
    Service svc(sensor, alarm);

    // SetArgReferee<0> writes the out-parameter; Return(0) is the return
    // value. DoAll chains them. This pair is the gmock answer to the custom
    // fake you had to hand-write in apps/08-fff-mocks.
    EXPECT_CALL(sensor, read(_))
        .Times(1)
        .WillOnce(DoAll(SetArgReferee<0>(quiet()), Return(0)));

    EXPECT_EQ(svc.tick(), 0);

    // No assertion needed at the end. `sensor` verifies itself when it goes
    // out of scope, and reports the failure against this test.
}

TEST(ServiceMock, QuietReadingsNeverTouchTheAlarm) {
    NiceMock<MockSensorPort> sensor;
    StrictMock<MockAlarmPort> alarm;
    Service svc(sensor, alarm);

    ON_CALL(sensor, read(_)).WillByDefault(DoAll(SetArgReferee<0>(quiet()), Return(0)));

    for (int i = 0; i < 5; ++i) {
        EXPECT_EQ(svc.tick(), 0);
    }

    // No EXPECT_CALL on `alarm` at all. Because it is a StrictMock, any call
    // to set() is an immediate failure. That is a stronger statement than
    // FFF's `zassert_equal(call_count, 0)`: it fails at the moment of the
    // call, with a stack trace, instead of at the end with a number.
}

// --------------------------------------------------------------------------
// 2. Argument matchers and call counts.
// --------------------------------------------------------------------------

TEST(ServiceMock, AlarmIsRaisedWithTrueWhenItGetsHot) {
    NiceMock<MockSensorPort> sensor;
    MockAlarmPort alarm;
    Service svc(sensor, alarm);

    ON_CALL(sensor, read(_)).WillByDefault(DoAll(SetArgReferee<0>(hot()), Return(0)));

    EXPECT_CALL(alarm, set(true)).Times(1);

    EXPECT_EQ(svc.tick(), 0);
}

TEST(ServiceMock, AlarmIsDrivenOnlyOnTheEdge) {
    NiceMock<MockSensorPort> sensor;
    MockAlarmPort alarm;
    Service svc(sensor, alarm);

    ON_CALL(sensor, read(_)).WillByDefault(DoAll(SetArgReferee<0>(hot()), Return(0)));

    // Four hot ticks, one call. Get the edge detection wrong and this fails
    // on the second tick, not at the end of the test.
    EXPECT_CALL(alarm, set(_)).Times(1);

    for (int i = 0; i < 4; ++i) {
        EXPECT_EQ(svc.tick(), 0);
    }
}

TEST(ServiceMock, AlarmGoesOnThenOffInThatOrder) {
    NiceMock<MockSensorPort> sensor;
    MockAlarmPort alarm;
    Service svc(sensor, alarm);

    // InSequence: ordering is part of the expectation. In FFF you would read
    // arg0_history[0] and arg0_history[1] and compare. Here the ordering is
    // the assertion.
    {
        InSequence seq;
        EXPECT_CALL(alarm, set(true));
        EXPECT_CALL(alarm, set(false));
    }

    EXPECT_CALL(sensor, read(_))
        .WillOnce(DoAll(SetArgReferee<0>(hot()), Return(0)))
        .WillOnce(DoAll(SetArgReferee<0>(cool()), Return(0)));

    EXPECT_EQ(svc.tick(), 0);
    EXPECT_EQ(svc.tick(), 0);
}

TEST(ServiceMock, HysteresisHoldsBetweenTheThresholds) {
    NiceMock<MockSensorPort> sensor;
    MockAlarmPort alarm;
    Service svc(sensor, alarm);

    const Reading between{(climate::kTempOnMilliC + climate::kTempOffMilliC) / 2,
                          100000, 40000};

    EXPECT_CALL(sensor, read(_))
        .WillOnce(DoAll(SetArgReferee<0>(hot()), Return(0)))
        .WillOnce(DoAll(SetArgReferee<0>(between), Return(0)));

    EXPECT_CALL(alarm, set(true)).Times(1);
    EXPECT_CALL(alarm, set(false)).Times(0);

    svc.tick();
    svc.tick();

    EXPECT_TRUE(svc.alarm());
}

// --------------------------------------------------------------------------
// 3. Making the dependency misbehave.
// --------------------------------------------------------------------------

TEST(ServiceMock, ReadErrorIsCountedAndReturned) {
    MockSensorPort sensor;
    StrictMock<MockAlarmPort> alarm;
    Service svc(sensor, alarm);

    EXPECT_CALL(sensor, read(_)).WillOnce(Return(-EIO));

    EXPECT_EQ(svc.tick(), -EIO);
    EXPECT_EQ(svc.errors(), 1u);
    EXPECT_EQ(svc.reads(), 0u);
}

TEST(ServiceMock, ReadErrorDoesNotClearARaisedAlarm) {
    NiceMock<MockSensorPort> sensor;
    MockAlarmPort alarm;
    Service svc(sensor, alarm);

    EXPECT_CALL(sensor, read(_))
        .WillOnce(DoAll(SetArgReferee<0>(hot()), Return(0)))
        .WillOnce(Return(-EIO));

    EXPECT_CALL(alarm, set(true)).Times(1);
    EXPECT_CALL(alarm, set(false)).Times(0);

    EXPECT_EQ(svc.tick(), 0);
    EXPECT_EQ(svc.tick(), -EIO);

    EXPECT_TRUE(svc.alarm());
}

TEST(ServiceMock, ThreeConsecutiveErrorsLatchAFault) {
    MockSensorPort sensor;
    NiceMock<MockAlarmPort> alarm;
    Service svc(sensor, alarm);

    // Exactly three. The fourth tick must not reach the sensor, and Times(3)
    // is what proves it: a fourth call fails the test the moment it happens.
    EXPECT_CALL(sensor, read(_)).Times(3).WillRepeatedly(Return(-EIO));

    for (int i = 0; i < Service::kMaxConsecutiveErrors; ++i) {
        EXPECT_EQ(svc.tick(), -EIO);
    }

    EXPECT_TRUE(svc.faulted());
    EXPECT_EQ(svc.tick(), -EIO);
}

TEST(ServiceMock, AGoodReadResetsTheConsecutiveCounter) {
    NiceMock<MockSensorPort> sensor;
    NiceMock<MockAlarmPort> alarm;
    Service svc(sensor, alarm);

    EXPECT_CALL(sensor, read(_))
        .WillOnce(Return(-EIO))
        .WillOnce(Return(-EIO))
        .WillOnce(DoAll(SetArgReferee<0>(quiet()), Return(0)))
        .WillOnce(Return(-EIO));

    for (int i = 0; i < 4; ++i) {
        svc.tick();
    }

    EXPECT_FALSE(svc.faulted());
    EXPECT_EQ(svc.errors(), 3u);
}

TEST(ServiceMock, ClearingAFaultLetsReadsResume) {
    NiceMock<MockSensorPort> sensor;
    NiceMock<MockAlarmPort> alarm;
    Service svc(sensor, alarm);

    EXPECT_CALL(sensor, read(_))
        .WillOnce(Return(-EIO))
        .WillOnce(Return(-EIO))
        .WillOnce(Return(-EIO))
        .WillOnce(DoAll(SetArgReferee<0>(quiet()), Return(0)));

    for (int i = 0; i < Service::kMaxConsecutiveErrors; ++i) {
        svc.tick();
    }
    ASSERT_TRUE(svc.faulted());

    svc.clearFault();

    EXPECT_EQ(svc.tick(), 0);
    EXPECT_EQ(svc.reads(), 1u);
}

// --------------------------------------------------------------------------
// 4. NiceMock, naggy and strict: the knob most people never touch.
// --------------------------------------------------------------------------

TEST(ServiceMock, PlainMockNagsAboutUninterestingCalls) {
    // A bare MockSensorPort with no EXPECT_CALL prints a GMOCK WARNING for
    // every call and still passes. That default is "naggy", and it is why a
    // large gmock suite ends up with hundreds of warnings nobody reads.
    //
    // NiceMock silences them. StrictMock turns them into failures. Pick per
    // mock, based on whether that dependency is what the test is about:
    //   - the mock you are asserting on   -> plain or StrictMock
    //   - a dependency that just has to exist -> NiceMock
    NiceMock<MockSensorPort> sensor;
    NiceMock<MockAlarmPort> alarm;
    Service svc(sensor, alarm);

    ON_CALL(sensor, read(_)).WillByDefault(DoAll(SetArgReferee<0>(quiet()), Return(0)));

    for (int i = 0; i < 3; ++i) {
        EXPECT_EQ(svc.tick(), 0);
    }

    EXPECT_EQ(svc.reads(), 3u);
}

// --------------------------------------------------------------------------
// 5. A matcher on a struct field, and the limit of all of this.
// --------------------------------------------------------------------------

TEST(ServiceMock, StoresTheReadingItWasGiven) {
    NiceMock<MockSensorPort> sensor;
    NiceMock<MockAlarmPort> alarm;
    Service svc(sensor, alarm);

    const Reading r{26123, 99000, 51000};
    EXPECT_CALL(sensor, read(_)).WillOnce(DoAll(SetArgReferee<0>(r), Return(0)));

    svc.tick();

    // Field() composes matchers over members, which beats three separate
    // EXPECT_EQ lines because a failure prints the whole object.
    EXPECT_THAT(svc.last(), Field(&Reading::temp_mc, 26123));
    EXPECT_THAT(svc.last(), Field(&Reading::hum_mrh, 51000));
}

TEST(ServiceMock, MocksSayNothingAboutTheRealImplementation) {
    // Same caveat as apps/08-fff-mocks, and it is worth repeating in a
    // different language: every test in this file passes with no hardware
    // anywhere, which means none of them can tell you the BME280 is on the
    // right I2C address, or that it is soldered on at all.
    //
    // apps/06-sensor answers that half. This app answers the other half very
    // quickly and in a debugger you already know how to use.
    NiceMock<MockSensorPort> sensor;
    NiceMock<MockAlarmPort> alarm;

    EXPECT_CALL(sensor, ready()).Times(AtLeast(1)).WillRepeatedly(Return(true));

    EXPECT_THAT(sensor.ready(), IsTrue());
}

}  // namespace
```
