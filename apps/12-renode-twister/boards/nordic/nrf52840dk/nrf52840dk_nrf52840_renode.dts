/* The stock board, unchanged. <..> resolves from $ZEPHYR_BASE/dts on the include path;
 * the stock board folder is not on it, so a plain "nrf52840dk_nrf52840.dts" fails.
 */
#include <../boards/nordic/nrf52840dk/nrf52840dk_nrf52840.dts>
