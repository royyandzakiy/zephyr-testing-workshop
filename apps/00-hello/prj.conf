## CMakeLists.txt
```
cmake_minimum_required(VERSION 3.20)
find_package(Zephyr REQUIRED HINTS $ENV{ZEPHYR_BASE})
project(hello)

target_sources(app PRIVATE
    src/main.c
)
```

## prj.conf
```kconfig
# printk() is on by default and there is no driver or devicetree node to set up.
# If this builds and runs, the toolchain works.
CONFIG_PRINTK=y
```

## boards/native_sim_native.conf
```kconfig
# Puts the console on the terminal that launched zephyr.exe, not a separate pty.
# Applied automatically for native_sim/native: the filename is the board target with '/' as '_'.
CONFIG_UART_NATIVE_PTY_0_ON_STDINOUT=y
```

## src/main.c
```c
#include <zephyr/kernel.h>
#include <zephyr/sys/printk.h>

int main(void)
{
    printk("Hello from the Zephyr testing workshop!\n");
    printk("Board: %s\n", CONFIG_BOARD_TARGET);

    return 0;
}
```
