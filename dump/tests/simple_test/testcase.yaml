## dump/tests/simple_test/testcase.yaml
```yaml
tests:
  biz_logic.testing.ztest:
    build_only: false
    platform_allow:
      - native_sim
    integration_platforms:
      - native_sim
    tags: test_framework
```
